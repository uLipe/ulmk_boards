/* Absolute MMIO symbols for IDF soc_*_struct.h externs */
PROVIDE(GPIO = 0x500E0000);
PROVIDE(IO_MUX = 0x500E1000);
PROVIDE(LEDC = 0x500D3000);
PROVIDE(I2C0 = 0x500C4000);
PROVIDE(TWAI0 = 0x500D7000);
PROVIDE(HP_SYS_CLKRST = 0x500E6000);
PROVIDE(SPIMEM2 = 0x5008E000);
PROVIDE(SPIMEM3 = 0x5008F000);
PROVIDE(Cache_PSRAM_MMU_Init = 0x4fc00514);
PROVIDE(Cache_PSRAM_MMU_Set = 0x4fc00520);
PROVIDE(Cache_Invalidate_Addr = 0x4fc003e4);
PROVIDE(Cache_WriteBack_Addr = 0x4fc003f4);
